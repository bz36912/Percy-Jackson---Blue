## CMakeLists.txt
```
# SPDX-License-Identifier: Apache-2.0

cmake_minimum_required(VERSION 3.20.0)
find_package(Zephyr REQUIRED HINTS $ENV{ZEPHYR_BASE})
project(central_hr)

FILE(GLOB app_sources src/*.c)
target_sources(app PRIVATE ${app_sources})
target_include_directories(app PRIVATE include)

zephyr_library_include_directories(${ZEPHYR_BASE}/samples/bluetooth)
```

## prj.conf
```kconfig
CONFIG_BT=y
# CONFIG_LOG=y
CONFIG_BT_CENTRAL=y
CONFIG_BT_SMP=y
CONFIG_BT_GATT_CLIENT=y
# CONFIG_BT_SHELL=y

CONFIG_CBPRINTF_FP_SUPPORT=y

# UART
CONFIG_SERIAL=y
CONFIG_UART_USE_RUNTIME_CONFIGURE=y
```

## src/main.c
```c
/**
 * @file main.c
 * @author Bolong Zhang
 * @brief Prac2 main entry point
 * @version 0.1
 * @date 2024-03-24
 * 
 * @copyright Copyright (c) 2024
 * 
 */
#include "ble_data.h"
#include "usb_uart.h"

/**
 * @brief main function
 * 
 * @return int, 0 on success
 */
int main(void)
{
	ble_setup();
	float readings[QUEUE_ELEM_SIZE];
	
	printf("before the while loop\n");
	while (true) {
		if (k_msgq_get(&bleQueue, &readings, K_MSEC(500)) == 0) {
			for (int i = 0; i < AD_MAX_NUM_READINGS; i += 1) {
				char buf[64];
				float* timeStep = readings + i * ACC_NUM_AXIS;
				float transIndex = readings[QUEUE_ELEM_SIZE - 1] + (float)i / (float)100.0;
				sprintf(buf, "{'x': %.2f, 'y': %.2f, 'z': %.2f, 'index': %.2f}", (double)timeStep[X_AXIS], 
					(double)timeStep[Y_AXIS], (double)timeStep[Z_AXIS], (double)transIndex);
				usb_uart_send_str(buf);
			}
		}
	}
	return 0;
}
```

## include/ble_data.h
```c
#ifndef RSSI_DATA_H
#define RSSI_DATA_H

#include "common_lib.h"
#include <zephyr/bluetooth/bluetooth.h>

// controls the advertisement
#define BLE_ADVERTISEMENT_DURATION 200 // in milli-seconds

#define ACC_NUM_AXIS 3
#define ACC_BYTES_PER_READING (ACC_NUM_AXIS * 2)
#define X_AXIS 0
#define Y_AXIS 1
#define Z_AXIS 2

// format parameter for the BLE protocol
#define AD_MAX_NUM_BYTES 28
#define AD_UUID_LEN 3
#define AD_INDEX_LEN 1
#define AD_PAYLOAD_LEN (AD_MAX_NUM_BYTES - AD_UUID_LEN - AD_INDEX_LEN)
#define AD_MAX_NUM_READINGS (int)(AD_PAYLOAD_LEN / ACC_BYTES_PER_READING)

#define QUEUE_ELEM_SIZE (AD_MAX_NUM_READINGS * ACC_NUM_AXIS + 1) // the numbeer of floats in each element
extern struct k_msgq bleQueue; // for passing information between the BLE thread to the UART thread

extern void ble_advertise_readings(float* readings);
extern void ble_setup();

#endif
```

## include/usb_uart.h
```c
#ifndef USB_UART_H
#define USB_UART_H

#include <zephyr/device.h>
#include <zephyr/drivers/uart.h>
#include "common_lib.h"

extern void usb_uart_send_str(char *str);
extern int usb_uart_setup();

#endif
```

## src/ble_data.c
```c
#include "ble_data.h"
#include <zephyr/bluetooth/hci.h>

static struct bt_le_scan_param scan_param = {
	.type       = BT_LE_SCAN_TYPE_PASSIVE,
	.options    = BT_LE_SCAN_OPT_NONE,
	.interval   = BT_GAP_SCAN_FAST_INTERVAL,
	.window     = BT_GAP_SCAN_FAST_WINDOW,
};

K_MSGQ_DEFINE(bleQueue, sizeof(float) * QUEUE_ELEM_SIZE, 20, 1);
static char targetAddr[BT_ADDR_LE_STR_LEN] = ""; // the BLE address to look/filter for

/**
 * @brief convert the encoded bytes into floats
 * 
 * @param input the encoded bytes
 * @param output floats
 */
static void ble_to_readings(uint8_t input[AD_PAYLOAD_LEN], float* output) {
    short temp;
    for (int i = 0; i < AD_PAYLOAD_LEN; i += 2) {
        memcpy(&temp, input + i, sizeof(temp));
        output[i / 2] = (float)temp / (float)100.0;
    }
}

/**
 * @brief NRF board uses this function to check if BLE device on the scan is Thingy:52
 * 
 * @param data the scanned device's data
 * @param addrStr the MAC address string of the scanned device
 * @return true there is more information after this packet
 * @return false all information of this packet is read
 */
static bool search_eir_found(struct bt_data *data, void *addrStr)
{
    const uint8_t AD_UUID[AD_UUID_LEN] = {0xF1, 0x45, 0x98};
    if (!memcmp(AD_UUID, data->data, AD_UUID_LEN)) {
        printf("FOUND the device. Its addr is %s, its length: %d, type: %d\n", (char*)addrStr, data->data_len, data->type);
        strcpy(targetAddr, (char*)addrStr);
    }
    return false;
}

static int transIndex = 0; // used to find duplicate advertisements being received
/**
 * @brief after finding the Thingy:52, this function reads the acceleration information 
 * in the Thingy:52 advertisement
 * 
 * @param data the scanned device's data
 * @param addrStr the MAC address string of the scanned device
 * @return true there is more information after this packet
 * @return false all information of this packet is read
 */
static bool extract_eir_found(struct bt_data *data, void *addrStr)
{
    float readings[QUEUE_ELEM_SIZE];
    if (data->data[AD_UUID_LEN] == transIndex) { // the bytes after UUID indexes the transmission over time
        printf("duplicate ad: %d\n", transIndex);
        return false; // this is a duplicate advertisement, so don't add to the queue
    }
    transIndex = data->data[AD_UUID_LEN];

    // creating the element to be added to the queue
    readings[QUEUE_ELEM_SIZE - 1] = data->data[AD_UUID_LEN]; 
    ble_to_readings((uint8_t*)(data->data) + AD_UUID_LEN + AD_INDEX_LEN, readings);
    if (k_msgq_put(&bleQueue, &readings, K_NO_WAIT)) {
        printf("adding to bleQueue failed\n");
    }
    return false;
}

/**
 * @brief callback when any device is found during scanning
 * 
 * @param addr addr of the device
 * @param rssi signal intensity
 * @param type type of device
 * @param ad its content of advertisement
 */
static void ble_scan_device_found(const bt_addr_le_t *addr, int8_t rssi, uint8_t type,
			 struct net_buf_simple *ad)
{
    char addrStr[BT_ADDR_LE_STR_LEN];
    bt_addr_le_to_str(addr, addrStr, sizeof(addrStr));
    if (strlen(targetAddr) == 0) { //find the device address
        printf("searching for device: %s, AD evt type %u, AD data len %u, RSSI %i\n",
		addrStr, type, ad->len, rssi);
        bt_data_parse(ad, search_eir_found, (void *)addrStr);
    } else { // use the found address to filter for the correct device
        if (strstr(addrStr, targetAddr) == NULL) {
            return; // wrong device
        }
        bt_data_parse(ad, extract_eir_found, (void *)addrStr);
    }
}

/**
 * @brief sets up the BLE in Zephyr
 * 
 */
extern void ble_setup() {
    int err;
	err = bt_enable(NULL);
    if (err) {
		printf("Bluetooth init failed (err %d)\n", err);
		return;
	}

    if (bt_le_scan_start(&scan_param, ble_scan_device_found)) {
        printf("rssi_scan(): scan failed to start");
    }
}
```

## src/usb_uart.c
```c
#include "usb_uart.h"

#define UART_DEVICE_NODE DT_CHOSEN(zephyr_shell_uart)
static const struct device *const usbUart = DEVICE_DT_GET(UART_DEVICE_NODE);

/**
 * @brief sends uart message
 * 
 * @param str the message
 */
extern void usb_uart_send_str(char *str)
{
	int msg_len = (int)(strlen(str));
	for (int i = 0; i < msg_len; i++) {
		uart_poll_out(usbUart, str[i]);
        // k_sleep(K_MSEC(1));
	}
	uart_poll_out(usbUart, '\n');
}

/**
 * @brief sets up the UART connection to the PC
 * 
 * @return int 0 on success, else it is an error
 */
extern int usb_uart_setup() {
	if (!device_is_ready(usbUart)) {
		printf("UART device not found!");
		return -1;
	}
	return 0;
}
```
