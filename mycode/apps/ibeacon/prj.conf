## CMakeLists.txt
```
# SPDX-License-Identifier: Apache-2.0

cmake_minimum_required(VERSION 3.20.0)
find_package(Zephyr REQUIRED HINTS $ENV{ZEPHYR_BASE})
project(ibeacon)

FILE(GLOB app_sources src/*.c)
target_sources(app PRIVATE ${app_sources})
target_include_directories(app PRIVATE include)

if(IBEACON_RSSI)
  zephyr_compile_definitions(IBEACON_RSSI=${IBEACON_RSSI})
endif()
```

## prj.conf
```kconfig
CONFIG_BT=y

# CONFIG_STDOUT_CONSOLE=y
CONFIG_I2C=y
CONFIG_SENSOR=y
CONFIG_CBPRINTF_FP_SUPPORT=y

# for debug prints from Thingy52
CONFIG_USE_SEGGER_RTT=y
CONFIG_RTT_CONSOLE=y
CONFIG_UART_CONSOLE=n
```

## src/main.c
```c
/**
 * @file main.c
 * @author Bolong Zhang
 * @brief the entry point for the Prac2 code for Thingy52
 * @version 0.1
 * @date 2024-03-24
 * 
 * @copyright Copyright (c) 2024
 * 
 */

#include "my_sensor.h"
#include "ble_data.h"

/**
 * @brief the main function
 * 
 * @return int, 0 on success
 */
int main(void)
{
	printf("Starting iBeacon Demo debug\n");
	ble_setup();
	// the sensors
	const struct device *const accMeter = DEVICE_DT_GET_ONE(st_lis2dh);
	mysensor_setup(accMeter);

	printf("before the while loop\n");
	while (true) {
		float readings[AD_MAX_NUM_READINGS * ACC_NUM_AXIS];
		for (int i = 0; i < AD_MAX_NUM_READINGS; i++) {
			float* values = readings + i * ACC_NUM_AXIS;
			if (!mysensor_process_array_data(accMeter, ACC_NUM_AXIS, SENSOR_CHAN_ACCEL_XYZ, values)) {
				printf("xyz: (%.2f, %.2f, %.2f)\n", (double)(values[X_AXIS]), (double)(values[Y_AXIS]), (double)(values[Z_AXIS]));
			}
			k_sleep(K_MSEC(BLE_ADVERTISEMENT_DURATION / AD_MAX_NUM_READINGS));
		}
		
		ble_advertise_readings(readings);
	}

	return 0;
}
```

## include/ble_data.h
```c
#ifndef RSSI_DATA_H
#define RSSI_DATA_H

#include "common_lib.h"
#include <zephyr/bluetooth/bluetooth.h>

// controls the advertisement
#define BLE_ADVERTISEMENT_DURATION BT_GAP_ADV_FAST_INT_MAX_1 // in milli-seconds
// custom Bluetooth config for fast advertisement
#define BT_LE_ADV_NCONN_FAST BT_LE_ADV_PARAM(0, BT_GAP_ADV_FAST_INT_MIN_1, \
					BT_GAP_ADV_FAST_INT_MAX_1, NULL)

#define ACC_NUM_AXIS 3
#define ACC_BYTES_PER_READING (ACC_NUM_AXIS * 2)
#define X_AXIS 0
#define Y_AXIS 1
#define Z_AXIS 2

// format parameter for the BLE protocol
#define AD_MAX_NUM_BYTES 28
#define AD_UUID_LEN 3
#define AD_INDEX_LEN 1
#define AD_PAYLOAD_LEN (AD_MAX_NUM_BYTES - AD_UUID_LEN - AD_INDEX_LEN)
#define AD_MAX_NUM_READINGS (int)(AD_PAYLOAD_LEN / ACC_BYTES_PER_READING)

extern void ble_advertise_readings(float* readings);
extern void ble_setup();

#endif
```

## include/common_lib.h
```c
/**
 * @file common_lib.h
 * @author Bolong Zhang
 * @brief includes the commonly used libraries and resources
 * @version 0.1
 * @date 2024-03-24
 * 
 * @copyright Copyright (c) 2024
 * 
 */
#ifndef COMMON_LIB_H
#define COMMON_LIB_H

#include <zephyr/types.h>
#include <zephyr/kernel.h>

#include <stddef.h>
#include <errno.h>
#include <stdio.h>
#include <stdlib.h>
#include <string.h>

#endif
```

## include/my_sensor.h
```c
/**
 * @file my_sensor.c
 * @author Bolong Zhang
 * @brief the sensors on the Thingy52
 * @version 0.1
 * @date 2024-03-24
 * 
 * @copyright Copyright (c) 2024
 * 
 */
#ifndef MY_SENSOR_H
#define MY_SENSOR_H

#include <zephyr/kernel.h>
#include <zephyr/device.h>
#include <zephyr/drivers/sensor.h>
#include <stdio.h>
#include <zephyr/sys/util.h>
#include <zephyr/drivers/sensor/ccs811.h>

int mysensor_process_sample(const struct device *dev, int numChannels, int* channels, float* values);
int mysensor_setup(const struct device *dev);
int mysensor_process_array_data(const struct device *dev, int arraySize, int channel, float* values);

#endif
```

## src/ble_data.c
```c
#include "ble_data.h"
#include <zephyr/bluetooth/hci.h>

static bool firstTime = true; // flag; true if advertisement has not started
static bool enablePrint = true; // enable additional debug print messages
static uint8_t indexCount = 0; // used to mark the chronogical order the adverts were advertised

/**
 * @brief encodes floats into bytes values
 * 
 * @param input the floats
 * @param output the encoded bytes values
 */
static void ble_to_bytes(float* input, uint8_t output[AD_PAYLOAD_LEN]) {
    for (int i = 0; i < AD_PAYLOAD_LEN; i += 2) {
        short temp;
        if (input > 0) {
            temp = (short)(input[i / 2] * (float)100.0 + (float)0.5);
        } else {
            temp = (short)(input[i / 2] * (float)100.0 - (float)0.5);
        }
        // printf("short (%d) has %d\n", temp, sizeof(temp));
        memcpy(output + i, &temp, sizeof(short));
    }
}

/**
 * @brief put the UUID and encoded accelerometer data into the BLE advertisment
 * 
 * @param readings the accelerometer data
 * @param output a buffer for recording the advertisement encoded as bytes
 * @return const struct bt_data contains the encoded bytes
 */
static const struct bt_data ble_create_advert(float* readings, uint8_t* output) {
    const uint8_t AD_UUID[AD_UUID_LEN] = {0xF1, 0x45, 0x98}; // 0x91
    memset(output, 0, (size_t)(AD_MAX_NUM_BYTES));
    // setting the UUID
    memcpy(output, AD_UUID, AD_UUID_LEN); // sets the UUID values
    indexCount++;
    if (indexCount > 255) {
        indexCount = 0;
    }
    output[AD_UUID_LEN] = indexCount; // the byte after the UUID indexes which advertisement it is over time

    ble_to_bytes(readings, output + AD_UUID_LEN + AD_INDEX_LEN);

    const struct bt_data content = {
        .type = BT_DATA_MANUFACTURER_DATA,
		.data = (const uint8_t*)output,
		.data_len = (uint8_t)(AD_MAX_NUM_BYTES)
    };

    return content;
}

/**
 * @brief starts advertising or updates if there was already an advertisement
 * 
 * @param readings the values to be advertised
 */
extern void ble_advertise_readings(float* readings) {
    uint8_t output[AD_MAX_NUM_BYTES];
    const struct bt_data content = ble_create_advert(readings, output);
	const struct bt_data ad[] = {
        content,
	};

    if (enablePrint) {
        printf("content length: %d, ad[] size:%d\n", content.data_len, ARRAY_SIZE(ad));
        for (int i = 0; i < content.data_len; i++) {
            printf("0x%X ", content.data[i]);
        }
        printf("\n");
    }

    // start/update the advertisement
	if (firstTime) {
        for (int i = 0; i < 3; i++) {
            int rc = bt_le_adv_start(BT_LE_ADV_NCONN_FAST, ad, ARRAY_SIZE(ad),
			NULL, 0);
		    if (rc) {
			    printf("ERROR: advert start failed, with error code: %d\n", rc);
		    } else {
                firstTime = false;
                printf("advert started SUCCESSFULLY\n");
                break;
            }
        }
	} else {
		int rc = bt_le_adv_update_data(ad, ARRAY_SIZE(ad), NULL, 0);
		if (rc) {
			printf("ERROR: advert update failed, with error code: %d\n", rc);
		}
	}
}

/**
 * @brief starts the BLE in Zephyr
 * 
 */
extern void ble_setup() {
    int err;
	err = bt_enable(NULL);
    if (err) {
		printf("Bluetooth init failed (err %d)\n", err);
		return;
	}
}
```

## src/my_sensor.c
```c
/**
 * @file my_sensor.c
 * @author Bolong Zhang
 * @brief the sensors on the Thingy52
 * @version 0.1
 * @date 2024-03-24
 * 
 * @copyright Copyright (c) 2024
 * 
 */
#include "my_sensor.h"

/**
 * @brief initiates a sensor
 * 
 * @param dev the sensor device
 * @return int, 0 on success
 */
int mysensor_setup(const struct device *dev) {
    printf("device is %p, name is %s\n", dev, dev->name);
    if (!device_is_ready(dev)) {
		printf("device not ready:\n");
		return -1;
	}
    return 0;
}

/**
 * @brief extracts the sensor reading
 * For hts221, the function extracts temperature and humidity together, by setting numChannel to 2
 * 
 * @param dev the sensor device
 * @param numChannels number of sensors contained in the sensor device
 * @param channels the index number indicating the types of sensor reading
 * @param values where the reading will be stored
 * @return int 
 */
int mysensor_process_sample(const struct device *dev, int numChannels, int* channels, float* values)
{
	struct sensor_value sensorValue;
	if (sensor_sample_fetch(dev) < 0) {
		printf("Sensor sample update error\n");
        printf("device is %p, name is %s\n", dev, dev->name);
		return -1;
	}

	// iterates through each channel
    for (int i = 0; i < numChannels; i++) {
        if (sensor_channel_get(dev, (enum sensor_channel)(channels[i]), &sensorValue) < 0) {
		    printf("Cannot read %dth channel (%d)\n", i, channels[i]);
            printf("device is %p, name is %s\n", dev, dev->name);
		    return -2;
	    }
        values[i] = (float)sensor_value_to_double(&sensorValue);
    }
    return 0;
}

/**
 * @brief extracts the sensor reading. Used when the sensor reading is stored as an array.
 * For accelerometer, the array is {x, y, z}
 * 
 * @param dev the sensor device
 * @param arraySize the number of values to read
 * @param channel the index number indicating the types of sensor reading
 * @param values where the readings will be stored
 * @return int 
 */
int mysensor_process_array_data(const struct device *dev, int arraySize, int channel, float* values) {
	struct sensor_value sensorValue[arraySize];
	if (sensor_sample_fetch(dev) < 0) {
		printf("Sensor sample update error\n");
        printf("device is %p, name is %s\n", dev, dev->name);
		return -1;
	}

	// selects the channel
	if (sensor_channel_get(dev, (enum sensor_channel)(channel), sensorValue) < 0) {
		printf("Cannot read channel (%d)\n", channel);
		printf("device is %p, name is %s\n", dev, dev->name);
		return -2;
	}
	// iterates through each value in the array
    for (int i = 0; i < arraySize; i++) {
        values[i] = (float)sensor_value_to_double(&(sensorValue[i]));
    }
    return 0;
}
```
